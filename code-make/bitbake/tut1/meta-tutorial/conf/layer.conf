## code-make/bitbake/tut1/meta-tutorial/conf/layer.conf
```bitbake
# https://a4z.bitbucket.io/docs/BitBake/guide.html
#
# LAYERDIR is a variable BitBake passes to the layer it loads.
# We append this path to the BBPATH variable.
# 
# BBFILES tells BitBake where recipes are.
# Currently we append nothing, but we will change this later.
#
# 5.2. Adding a recipe location to the tutorial layer
#
# BitBake needs to know about which recipes a layer provides.
# We edit our meta-tutorial/conf/layer.conf file and tell BitBake to load all
# recipe files by using a common pattern.

BBPATH .= ":${LAYERDIR}"
BBFILES += "${LAYERDIR}/recipes-*/*/*.bb"

# 7.3. Extending the layer configuration
#
# a layer collection name
#
# a search pattern for files to add
#
# a layer priority
#
# append layer name to list of configured layers
BBFILE_COLLECTIONS += "tutorial"
# and use name as suffix for other properties
BBFILE_PATTERN_tutorial = "^${LAYERDIR}/"
BBFILE_PRIORITY_tutorial = "5"

# 7.4. Layer compatibility
# A project like yocto is composed out of very many layers. To ensure used layer
# are compatible with a project version, a project can define a layer series
# name, and layers can specify to be compatible to one, or multiple, layer
# series.
# 
# In practice, for a yocto project, each release defines its release name as its
# layer series core name. Layers that are tested for this release can add the
# compatibility name in its config. If a layer is added that does not have the
# compatibility name specified, bitbake will tell about this by showing a
# warning.
#
# 7.4.1. Layer series core name First we define a 'project core name'. This is
# done by setting the LAYERSERIES_CORENAMES variable.

LAYERSERIES_CORENAMES = "bitbakeguilde"

# 7.4.2. Layer series compatibility
# We also need to specify that the tutorial layer is compatible with the
# bitbakeguilde. This can be done by setting LAYERSERIES_COMPAT_...
# variable in the in the layer.conf files of *each layer.*
#
# The variable ends on the layer name

LAYERVERSION_tutorial = "1"
LAYERSERIES_COMPAT_tutorial = "bitbakeguilde"
```

## code-make/bitbake/tut1/meta-two/conf/layer.conf
```bitbake
# 7.1. Adding an additional layer

BBPATH .= ":${LAYERDIR}"


# 8.2. bbappend files
# An append file can be use to add functions to an existing class without
# creating a new one.  It adds the text of the append file to a class with the
# same name.
# 
# To be able to use append files the layer needs to be set up to load also them
# in addition to normal recipes.  Therefore we change our layer configuration
# and add loading of *.bbappend file to the BBFILES variable.

# BBFILES += "${LAYERDIR}/recipes-*/*/*.bb"

BBFILES += "${LAYERDIR}/recipes-*/*/*.bb \
            ${LAYERDIR}/recipes-*/*/*/.bbappend"

# 7.3. Extending the layer configuration

BBFILE_COLLECTIONS += "two"
BBFILE_PATTERN_two = "^${LAYERDIR}/"
BBFILE_PRIORITY_two = "5"
LAYERVERSION_two = "1"

# 7.4. Layer compatibility
# A project like yocto is composed out of very many layers. 
#
# To ensure used layer are compatible with a project version, a project can
# define a layer series name, and layers can specify to be compatible to one, or
# multiple, layer series.
#
# 7.4.2. Layer series compatibility
# We also need to specify that the tutorial layer is compatible with the
# bitbakeguilde. This can be done by setting LAYERSERIES_COMPAT_...
# variable in the in the layer.conf files of *each layer.*
#
# The variable ends on the layer name

# 7.5. Layer dependencies
# You might have noticed that we also specified the LAYERDEPENDS_two variable in
# the layer.conf file of our second layer, meta-two.
#
# By doing so we inform bitbake that this layer has a dependency to the tutorial
# layer. We well see in the next chapter, when we add more content to the
# meta-two layer, why this is the case.

LAYERDEPENDS_two = "tutorial"

LAYERSERIES_COMPAT_two = "bitbakeguilde"
```
